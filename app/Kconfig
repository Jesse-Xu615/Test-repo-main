## app/Kconfig
```kconfig
choice
	prompt "Applications"

config DEMO_CMDLINE
	bool "Command-line demo"

config DEMO_SIMPLE_WIFI
	bool "Simple Wi-Fi demo"
	select WISE_API

config DEMO_API_WIFI
	bool "Wi-Fi API demo"
	select SDK
	select API_WIFI

config DEMO_MQTT 
	bool "MQTT demo"
	select SDK
	select API_WIFI
	select MQTT
	select COREMQTT
	select COREMQTT_AGENT
	select CMDLINE

config BOOTLOADER
	bool "wise-boot"

config WATCHER
	bool "wise watcher"

config IRQ_DISPATCHER
	bool "irq_dispatcher"

config BOOTROM
    bool "wise-rom"
	select USE_DEFAULT_CLK if SOC_SCM2010

config MCUBOOT_BL
    bool "wise-mcuboot"

config ATE
    bool "ATE tests"
	depends on SOC_SCM2010

#config TEST_PBUF
#	bool "pbuf test"

#config TEST_CALLOUT
#	bool "callout test"

#config TEST_TASKQ
#	bool "taskqueue test"

endchoice

if BOOTLOADER
source "app/boot/Kconfig"
endif

if BOOTROM
source "app/rom/Kconfig"
endif

if DEMO_SIMPLE_WIFI
source "app/demo/simple_wifi/Kconfig"
endif

if DEMO_API_WIFI
source "api/examples/wifi/Kconfig"
endif

if DEMO_MQTT
source "api/examples/mqtt/Kconfig"
endif

if WATCHER
source "app/watcher/Kconfig"
endif

if IRQ_DISPATCHER
source "app/irqd//Kconfig"
endif

if MCUBOOT_BL
source "app/mcuboot/Kconfig"
endif

if ATE
source "app/ate/Kconfig"
endif
```

## app/Kconfig.sdk
```kconfig
choice
	prompt "Applications"

config DEMO_CMDLINE
	bool "Command-line demo"

config DEMO_SIMPLE_WIFI
	bool "Simple Wi-Fi demo"
	select WISE_API

config DEMO_API_WIFI
	bool "Wi-Fi API demo"
	select SDK
	select API_WIFI

config DEMO_MQTT 
	bool "MQTT demo"
	select SDK
	select API_WIFI
	select MQTT
	select COREMQTT
	select COREMQTT_AGENT
	select CMDLINE

config MCUBOOT_BL
    bool "wise-mcuboot"

endchoice

if DEMO_SIMPLE_WIFI
source "app/demo/simple_wifi/Kconfig"
endif

if DEMO_API_WIFI
source "api/examples/wifi/Kconfig"
endif

if DEMO_MQTT
source "api/examples/mqtt/Kconfig"
endif

if MCUBOOT_BL
source "app/mcuboot/Kconfig"
endif
```

## app/ate/Kconfig
```kconfig
menu "ATE tests"

config ATE_DEBUG_UART
	bool "Use UART debug instead of GPIO"
	default n

config ATE_SUPPORT_INT
	bool
	default n

config ATE_MAX_BUS_CLK
	bool "Use maximum bus clocks"
	default y

config ATE_PORBOR
	bool "Perform PORBOR test"
	default n

config ATE_EFUSE
	bool "Perform eFuse test"
	default n

config ATE_AUXADC
	bool "Perform AUXADC test"
	default n
	select ATE_SUPPORT_INT

config ATE_SYSMEM
	bool "Perform SYS memory test"
	default n

config ATE_32KRC
	bool "Perform 32K RC OSC test"
	default n
	select ATE_SUPPORT_INT

config ATE_USBPHY
	bool "Perform USB PHY simple test"
	default n

config ATE_LOWPOWER
	bool "Perform LowPower test"
	default n

config ATE_SPIFLASH
	bool "Perform SPI flash test"
	default n

config ATE_IOLEAKAGE
	bool "Perform IO leakage test"
	default n

config ATE_GPIO_DONE
    int "GPIO to control when test is done"
	default 21

config ATE_GPIO_VERDICT
    int "GPIO to control for verdict"
	default 22

config ATE_BIN
	string "Name of the ATE binary file"
	default "wise-ate.bin"

endmenu
```

## app/boot/Kconfig
```kconfig
menu "Boot related configuration"

comment "Build"

config BOOT_BIN
	string "Name of the boot loader binary file"
	default "wise-boot.bin"

config BOOT_TIMEOUT
    int "Seconds to wait before entering CLI mode"
    default 3

comment "Partition table"

config PT_NUTTX_SIZE
	int "Partition size for NuttX binary in KBytes."
	default 1024

config PT_WISE_SIZE
	int "Partition size for wise binary in KBytes."
	default 1024

endmenu
```

## app/demo/simple_wifi/Kconfig
```kconfig
menu "Simple Wi-Fi configuration"

choice WIFI_MODE
    prompt "AP or STA"
    default WIFI_MODE_STATION
    help
        Select the wi-fi mode as softAP or station.

config WIFI_MODE_SOFTAP
    bool "SoftAP"
config WIFI_MODE_STATION
    bool "Station"
endchoice

config WIFI_MODE_AP
    bool
    default y if WIFI_MODE_SOFTAP
    default n if WIFI_MODE_STATION

config WIFI_SSID
    string "WiFi SSID"
    default "myssid"
    help
	SSID (network name) for the example to connect to.

config WIFI_PASSWORD
    string "WiFi Password"
    default "mypassword"
    help
	WiFi password (WPA or WPA2) for the example to use.
		
config MAX_STA_CONN
    int "Max STA conn"
    default 4
    help
	Max number of the STA connects to AP.

endmenu
```

## app/irqd/Kconfig
```kconfig
menu "irq_dispatcher"

config IRQD_ENABLE_DEBUG
   bool "Enable debug output via UART"
   default y

config IRQD_BIN
	string "Name of irq_dispatcher binary file"
	default "wise-irqd.bin"

endmenu
```

## app/rom/Kconfig
```kconfig
menu "ROM related configuration"

config UART_BOOT
	bool "Support UART Boot"
	default n
    select XYZMODEM

config USB_BOOT
	bool "Support USB Boot"
	default n
	select TINYUSB
	select TUSB_TUD_DFU_RUNTIME
	select TUSB_TUD_DFU

config SDIO_BOOT
	bool "Support SDIO Boot"
	default n

config FLASH_PROTECTION
	bool "Support flash protection"
	default n

config SECURE_BOOT
	bool "Support secure boot"
	default n

config ANTI_ROLLBACK
	bool "Support anti-rollback protection"
	default n

endmenu
```

## app/watcher/Kconfig
```kconfig
menu "Watcher related configuration"

config PM_TEST
   bool "Enable power managment test"
   default n

config WATCHER_FILTER_MULTICAST
   bool "Enable multicast filter in Watcher"
   default y

config WATCHER_FILTER_TCP
   bool "Enable TCP Filter in Watcher"
   default y

config WATCHER_FILTER_UDP
   bool "Enable UDP Filter in Watcher"
   default y

config WATCHER_TX_KEEPALIVE
   bool "Enable TX Null for Keepalive"
   depends on !WATCHER_TX_GARP
   default y

if WATCHER_TX_KEEPALIVE
config NULL_PERIODIC_TX_TIME
   int "Null packet tx time cycle as sec unit"
   default 60
endif

config WATCHER_TX_GARP
   bool "Enable TX GARP for keepalive and arp table update"
   depends on !WATCHER_TX_KEEPAVLIE
   default n

if WATCHER_TX_GARP
config GARP_PERIODIC_TX_TIME
   int "GARP packet tx time cycle as sec unit"
   default 60
endif

config WATCHER_TX_ARP_RESP
   bool "Enable ARP Response about Request"
   default y

config CONS_BCN_LOSS_THRESHOLD
   int "consecutive BCN loss count(threshold)"
   default 20

config WATCHER_TX_UDPHOLE
   bool "Enable UDP Hole punch tx"
   default n

if WATCHER_TX_UDPHOLE
config UDPHOLE_PERIODIC_TX_TIME
   int "UDP Hole packet tx time cycle as min unit"
   default 3
endif

config WATCHER_TX_TCPHOLE
   bool "Enable TCP Hole punch tx"
   default n

if WATCHER_TX_TCPHOLE
config TCPHOLE_PERIODIC_TX_TIME
   int "TCP Hole packet tx time cycle as min unit"
   default 3
endif
config WATCHER_IN_WISE_ONLY
   bool "Working in WISE ONLY"
   default y
endmenu
```
